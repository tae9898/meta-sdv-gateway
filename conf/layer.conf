## conf/layer.conf
```bitbake
# We have a conf and classes directory, add to BBPATH
BBPATH .= ":${LAYERDIR}"

# We have recipes-* directories, add to BBFILES
BBFILES += "${LAYERDIR}/recipes-*/*/*.bb \
            ${LAYERDIR}/recipes-*/*/*.bbappend"

BBFILE_COLLECTIONS += "meta-sdv-gw"
BBFILE_PATTERN_meta-sdv-gw = "^${LAYERDIR}/"
BBFILE_PRIORITY_meta-sdv-gw = "7"

LAYERSERIES_COMPAT_meta-sdv-gw = "scarthgap"

# Additional license directories.
LICENSE_PATH += "${LAYERDIR}/licenses"

LAYERDEPENDS_meta-sdv-gw = "core meta-python rauc raspberrypi lts-u-boot-mixin"
```
